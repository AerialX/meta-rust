## conf/layer.conf
```bitbake
BBPATH .= ":${LAYERDIR}"
BBFILES += "${LAYERDIR}/recipes*/*/*.bb ${LAYERDIR}/recipes*/*/*.bbappend"

BBFILE_COLLECTIONS += "meta-rust"
BBFILE_PATTERN_meta-rust := "^${LAYERDIR}/"
BBFILE_PRIORITY_meta-rust = "5"

LICENSE_PATH += "${LAYERDIR}/licenses"
```
